## allwinner/wireless/wifimanager2.0/Config.in
```kconfig
if PACKAGE_wifimanager-v2.0
	if PACKAGE_wifimanager-v2.0-demo
		config WMG_PROTOCOL_SOFTAP
			bool "CONFIG_WMG_PROTOCOL_SOFTAP"
			default n
			help
				softap net config.

		config WMG_PROTOCOL_BLE
			bool "CONFIG_WMG_PROTOCOL_BLE"
			default n
			help
				ble net config.

		config WMG_PROTOCOL_XCONFIG
			bool "CONFIG_WMG_PROTOCOL_XCONFIG"
			default n
			help
				xconfig net config.

		config WMG_PROTOCOL_SOUNDWAVE
			bool "CONFIG_WMG_PROTOCOL_SOUNDWAVE"
			default n
			help
				soundwave net config.
	endif
endif
```

## gui/flutter/flutter-sunxi/Config.in
```kconfig
if PACKAGE_flutter-sunxi

config FLUTTER_USE_FBDEV
	bool "flutter use fbdev"
	default y
		help
		Whether use flutter_fbdev

config FLUTTER_USE_EGLFS
	bool "flutter use eglfs"
	default n
		help
		Whether use flutter_eglfs

config FLUTTER_DEMO_COMPLEX_LAYOUT
	bool "flutter demo complex layout"
	select FLUTTER_USE_FBDEV
	default n
		help
		Whether use flutter demo complex layout

config FLUTTER_DEMO_GALLERY
	bool "flutter demo gallery"
	select FLUTTER_USE_FBDEV
	default n
		help
		Whether use flutter demo complex gallery

endif
```

## gui/littlevgl-6/smartva/Config.in
```kconfig
if PACKAGE_smartva

config lvgl
    bool "Enabel lvgl core"
    default y
        help
	lvgl core

config lv_drivers
    bool "Enabel lvgl drivers"
    default y
        help
	lvgl drivers

config lv_examplesp
    bool "Enabel lvgl examples"
    default y
        help
	lvgl examples

config story
    bool "Enabel story"
    default y
        help
	story-machine: 800X480 screen

choice TP_USE
	default CTP_USE
    bool "Choose the tp type"

    config CTP_USE
	bool "use ctp"

	config RTP_USE
	bool "use rtp"
	select PACKAGE_tslib
	select TSLIB_ENABLE_input
	select TSLIB_ENABLE_dejitter
endchoice
endif
```

## gui/littlevgl-6/smartva_ota/Config.in
```kconfig
if PACKAGE_smartva_ota

config lvgl
    bool "Enabel lvgl core"
    default y
        help
	lvgl core

config lv_drivers
    bool "Enabel lvgl drivers"
    default y
        help
	lvgl drivers

config story_ota
    bool "Enabel story ota"
    default y
        help
	story-machine: 800X480 screen

choice TP_USE
	default CTP_USE
    bool "Choose the tp type"

    config CTP_USE
	bool "use ctp"

	config RTP_USE
	bool "use rtp"
	select PACKAGE_tslib
	select TSLIB_ENABLE_input
	select TSLIB_ENABLE_dejitter
endchoice
endif
```

## gui/minigui/libminigui-gpl/Config.in
```kconfig
if PACKAGE_libminigui-gpl
choice
prompt "Preferred Minigui Run Mode"
	default MINIGUI_THS
	help
	Select the preferred minigui running mode.
config MINIGUI_THS
	bool "ths"
config MINIGUI_PROC
	bool "proc"
endchoice
config TTF2_SUPPORT
    bool "Enabel truetype font support"
    default y
        help
          Enabling True type font support for minigui.
          You need config the font path in MiniGUI.cfg.
          And add font in res path.
          Unless you know what you are doing, you should leave this as 'n'
config TSLIB_SUPPORT
    bool "Enabel tslib support for MiniGUI"
    default n
        help
          Enabling tslib ial support for minigui.
          You need config ialengine in MiniGUI.cfg.
          And add pointercal in /etc directory.
		  Unless you know what you are doing, you should leave this as 'n'
config MINIGUI_G2D_SUPPORT
    bool "Enabel g2d support for MiniGUI"
    default n
        help
        Enabling g2d support for minigui
config MINIGUI_G2D_ROTATE_SUPPORT
    bool "Enabel g2drotate support for MiniGUI"
    select MINIGUI_G2D_SUPPORT
    default n
        help
        Enabling g2drotate support for minigui
config MINIGUI_GPU_SUPPORT
    bool "Enabel gpu support for MiniGUI"
    default n
        help
        Enabling gpu support for minigui
config MINIGUI_GPU_ROTATE_SUPPORT
    bool "Enabel gpurotate support for MiniGUI"
    select MINIGUI_GPU_SUPPORT
    default n
        help
        Enabling gpurotate support for minigui
config SUNXIFB_SUPPORT
    bool "Enabel sunxifb support for MiniGUI"
    default n
        help
        Enabling sunxifb support for minigui
config SUNXIFBION_SUPPORT
    bool "Enabel sunxifbion support for MiniGUI"
    default n
        help
        Enabling sunxifbion support for minigui
config TEXT_ROTATE_SUPPORT
    bool "Enabel text rotate support for MiniGUI"
    default n
        help
        Enabling text rotate support for minigui
config CCW_SUPPORT
    bool "Enabel coortrans cw support for MiniGUI"
    default n
        help
          Enabling rotate support for minigui.
          You need config system in MiniGUI.cfg.
          And adjust the width and height.
		  Unless you know what you are doing, you should leave this as 'n'
config BUILD_LIB_MIN
    bool "Enabel reduce size for MiniGUI"
    default n
        help
          Reduce the unwanted function module of minigui.
          You need config system in MiniGUI.cfg.
          Adust the font config and reduce cursor resource.
		  Unless you know what you are doing, you should leave this as 'n'
endif
```

## testunit/network/bt/Config.in
```kconfig
menuconfig TESTUNIT_NETWORK_BT
    bool "bt"
    default y
    select PACKAGE_btmanager-core
    select PACKAGE_btmanager-demo
```
